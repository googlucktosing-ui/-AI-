## sdkconfig.defaults.lichuang-dev
```kconfig
CONFIG_BOARD_TYPE_LICHUANG_DEV_S3=y
CONFIG_USE_AUDIO_PROCESSOR=y
CONFIG_USE_DEVICE_AEC=n
CONFIG_USE_SERVER_AEC=n
CONFIG_SR_WN_WN9_NIHAOXIAOZHI_TTS=y
CONFIG_FATFS_LFN_HEAP=y
CONFIG_FATFS_CODEPAGE_936=y
CONFIG_FATFS_API_ENCODING_UTF_8=y
CONFIG_FATFS_VFS_FSTAT_BLKSIZE=4096
```
